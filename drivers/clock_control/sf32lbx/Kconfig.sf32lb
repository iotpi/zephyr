## drivers/clock_control/sf32lbx/Kconfig.sf32lb
```kconfig
# Copyright (c) 2025 Qingdao IotPi Ltd.
# SPDX-License-Identifier: Apache-2.0

config CLOCK_CONTROL_SF32LB_CLK
    bool "SF32LBx clock control drivers"
    default y
    depends on DT_HAS_SIFLI_SF32LB_XT_CLK_ENABLED || \
    DT_HAS_SIFLI_SF32LB_RC_CLK_ENABLED

config CLOCK_CONTROL_SF32LB_HPSYS
    bool "SF32LB HPSYS clock control drivers"
    default y
    depends on DT_HAS_SIFLI_SF32LB_HPSYS_RCC_ENABLED || \
    DT_HAS_SIFLI_SF32LB_HPSYS_AON_ENABLED || \
    DT_HAS_SIFLI_SF32LB_PERI_HPSYS_CLK_ENABLED
```

## drivers/pinctrl/Kconfig.sf32lb_hpsys
```kconfig
# Copyright (c) 2025 Qingdao IotPi Ltd.
# SPDX-License-Identifier: Apache-2.0

config PINCTRL_SF32LB_HPSYS
       bool "Pin Controller driver for Sifli SF32LBx HPSYS"
       default y
       depends on DT_HAS_SIFLI_SF32LB_HPSYS_PINMUX_ENABLED
       help
         Enable Pin Controller driver for Sifli SF32LB HPSYS
```

## dts/bindings/clock/sifli,sf32lb-hpsys-aon.yaml
```yaml
# Copyright (c) 2025 Qingdao IotPi Ltd.
# SPDX-License-Identifier: Apache-2.0

description: |
  Sifli SF32LBx HPSYS AON register

compatible: "sifli,sf32lb-hpsys-aon"

include: [clock-controller.yaml, base.yaml]

clock-cells:
  - subsys
```

## dts/bindings/clock/sifli,sf32lb-hpsys-peri-clk.yaml
```yaml
# Copyright (c) 2025 Qingdao IotPi Ltd.
# SPDX-License-Identifier: Apache-2.0

description: |
  Sifli SF32LB HPSYS Peripheral Clock Controller

compatible: "sifli,sf32lb-hpsys-peri-clk"

include: [fixed-clock.yaml]
```

## dts/bindings/clock/sifli,sf32lb-rc-clock.yaml
```yaml
# Copyright (c) 2025 Qingdao IotPi Ltd.
# SPDX-License-Identifier: Apache-2.0

description: |
  Sifli SF32LB internal RC based clock, namely hrc48 and lrc10

compatible: "sifli,sf32lb-rc-clk"

include: [base.yaml, clock-controller.yaml, fixed-clock.yaml]
    
```
